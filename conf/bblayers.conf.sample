## conf/bblayers.conf.sample
```bitbake
LCONF_VERSION = "7"

BBPATH = "${TOPDIR}"
BSPDIR := "${@os.path.abspath(os.path.dirname(d.getVar('FILE', True)) + '/../..')}"

BBFILES ?= " ${BSPDIR}/sources/meta-dt-framework/images/*.bb"
BBLAYERS = " \
  ${BSPDIR}/sources/meta-nanopi-rockchip64 \
  \
  ${BSPDIR}/sources/meta-openembedded/meta-oe \
  ${BSPDIR}/sources/meta-openembedded/meta-python \
  ${BSPDIR}/sources/meta-openembedded/meta-networking \
  ${BSPDIR}/sources/meta-openembedded/meta-filesystems \
  \
  ${BSPDIR}/sources/poky/meta \
  ${BSPDIR}/sources/poky/meta-poky \
"
```

## conf/layer.conf
```bitbake
# We have a conf and classes directory, append to BBPATH
BBPATH .= ":${LAYERDIR}"

# We have a recipes directory, add to BBFILES
BBFILES += "${LAYERDIR}/recipes*/*/*.bb ${LAYERDIR}/recipes*/*/*.bbappend"

BBFILE_COLLECTIONS += "meta-nanopi-rockchip64"
BBFILE_PATTERN_meta-nanopi-rockchip64 := "^${LAYERDIR}/"
BBFILE_PRIORITY_meta-nanopi-rockchip64 = "10"
LAYERSERIES_COMPAT_meta-nanopi-rockchip64 = "warrior zeus dunfell"
```

## conf/machine/include/rk3328.inc
```bitbake
require rockchip64.inc

SOC_FAMILY = "rk3328"
UBOOT_PATCHES ?= "rk3328"

RK_BIN_DIR = "rk33"
DDR_BLOB = "rk3328_ddr_333MHz_v1.16.bin"
MINILOADER_BLOB = "rk322xh_miniloader_v2.50.bin"
BL31_BLOB = "rk322xh_bl31_v1.42.elf"

SPL_BINARY = "u-boot-dtb.bin"

# Add the wks creation class. This will enable the custom
# wks file creation per image
IMAGE_FSTYPES += "ext4 rkboot wksbuild wic.bz2 wic.bmap"
IMAGE_CLASSES += "rk-boot-partition rk-create-wks"
```

## conf/machine/include/rockchip64.inc
```bitbake
include conf/machine/include/arm/arch-armv8a.inc
include conf/machine/include/soc-family.inc

KERNEL_IMAGETYPE ?= "Image"

UBOOT_BINARY ?= "u-boot.itb"

KERNEL_DEVICETREE ?= "${ROCKCHIP64_KERNEL_DEVICETREE}"

OVERLAY_PREFIX ?= "rockchip"

SERIAL_CONSOLES = "1500000;ttyS2 1500000;ttyGS0"

PREFERRED_PROVIDER_virtual/kernel ?= "linux-stable"
PREFERRED_VERSION_linux-stable ?= "5.7%"

PREFERRED_VERSION_u-boot ?= "v2020.07%"
PREFERRED_RPROVIDER_u-boot-fw-utils ?= "u-boot-fw-utils"
PREFERRED_VERSION_u-boot-fw-utils ?= "v2020.07%"
```

## conf/machine/nanopi-r2s.conf
```bitbake
#@TYPE: Machine
#@NAME: nanopi-duo
#@DESCRIPTION: Machine configuration for the FriendlyARM NanoPi Duo, based on the Allwinner H2 CPU

require conf/machine/include/rk3328.inc

# KERNEL_DEVICETREE is already set in rockchip64.inc to support the overlays
# and ROCKCHIP64_KERNEL_DEVICETREE will be appended to KERNEL_DEVICETREE
ROCKCHIP64_KERNEL_DEVICETREE = "rockchip/rk3328-nanopi-r2-rev00.dtb"
UBOOT_CONFIG = "nanopi-r2s-rk3328_defconfig"

DEFAULT_OVERLAYS = ""
MODULES = "g_serial"
MODULES_BLACKLIST = "rockchipdrm analogix_dp dw_mipi_dsi dw_hdmi gpu_sched lima"
BUILD_DESKTOP = "no"

MACHINE_FEATURES_append ?= ""

# Remove conflicting backends.
DISTRO_FEATURES_remove = "wayland x11"
```
